## boards/firefly/roc_rk3568_pc/Kconfig.roc_rk3568_pc
```kconfig
# Copyright 2022 HNU-ESNL
# Copyright 2022 openEuler SIG-Zephyr
# SPDX-License-Identifier: Apache-2.0

config BOARD_ROC_RK3568_PC
	select SOC_RK3568

#ifdef BOARD_ROC_RK3568_PC

config RK3568_CLOCK_CONTROL_INIT_PRIORITY
	int "Clock control init priority"
	help
	  Clock control driver device initialization priority for rk3568.

#endif
```

## drivers/clock_control/Kconfig.rk3568
```kconfig
# Copyright (c) 2023, HNU-ESNL
# SPDX-License-Identifier: Apache-2.0

config CLOCK_CONTROL_RK3568
	bool "RK3568 CLOCK CONTROLLER"
	help
	  Enable support for rk3568 clock controller driver.
```

## drivers/sdhc/Kconfig.sdhc_rockchip
```kconfig
# Copyright (c) 2023 Intel Corporation
# SPDX-License-Identifier: Apache-2.0

config ROCKCHIP_SDHC
	bool "ROCKCHIP SDHC"
	default y
	depends on DT_HAS_ROCKCHIP_SDHC_ENABLED
	select SDHC_SUPPORTS_NATIVE_MODE
	help
		Enable Cadence SDMMC Host Controller.

if ROCKCHIP_SDHC

# Cadence SDHC DMA needs 64 bit aligned buffers
config SDHC_BUFFER_ALIGNMENT
	default 8

config ROCKCHIP_DESC_COUNT
	int "Allocate number of descriptors"
	default 8
	help
		SD host controllers require DMA preparation for read and write operation.
		Creates static descriptors which can be used by ADMA. Devices should
		configure this flag if they require to transfer more than 8*64Kb of data.

config ROCKCHIP_SDHC_DMA_ENABLED
	bool "Enable SDHC DMA"
	default y
	help
		ROC SD host controllers with DMA

endif # ROCKCHIP_SDHC
```

## dts/bindings/clock/rockchip,rk3568-cru.yaml
```yaml
# Copyright (c) 2022, NXP
# SPDX-License-Identifier: Apache-2.0


description: |
  The RK3568 clock controller generates the clock and also implements a
  reset controller for SoC peripherals.
  (examples: provide SCLK_UART1\PCLK_UART1 and SRST_P_UART1\SRST_S_UART1 for UART module)

compatible: "rockchip,rk3568-cru"

include: [clock-controller.yaml, base.yaml, pinctrl-device.yaml]

properties:
  reg:
    required: true

  rockchip,grf:
    type: phandle

  assigned-clocks:
    type: compound

  assigned-clock-rates:
    type: array

  assigned-clock-parents:
    type: compound

  "#clock-cells":
    const: 1

clock-cells:
  - clk-id
```

## dts/bindings/clock/rockchip,rk3568-pmucru.yaml
```yaml
# Copyright (c) 2022, NXP
# SPDX-License-Identifier: Apache-2.0


description: |
  The RK3568 clock controller generates the clock and also implements a
  reset controller for SoC peripherals(PMU).

compatible: "rockchip,rk3568-pmucru"

include: [clock-controller.yaml, base.yaml]

properties:
  reg:
    required: true

  "#clock-cells":
    const: 1
  rockchip,grf:
    type: phandle

  # "#reset-cells":
  #   type: int
  #   const: 1
  #   required: true

clock-cells:
  - name
```

## dts/bindings/sdhc/rockchip,sdhc.yaml
```yaml
description: Rockchip SDHC Controller node

compatible: "rockchip,sdhc"

include: [sdhc.yaml, reset-device.yaml]

properties:
  clock-frequency:
    type: int
    required: false
    description: clock-frequency for SDHC
  reg:
    required: true
    description: register space
  power_delay_ms:
    type: int
    required: false
    description: delay required to switch on the SDHC

  dma_desc_base:
    type: int
    required: true
    description: memregion save the descriptors

  dma_desc_size:
    type: int
    required: true
    description: memregion size
```

## samples/subsys/zvm/dts/bindings/rtos-vm.yaml
```yaml
description: RTOS Virtual Machine Space

compatible: "rtos-vm"

properties:
  dtb_address:
    type: int
    description: |
      Base address of the VM device tree file.
    required: false

  # dtb_size:
  #   type: int
  #   description: |
  #     Size of the VM device tree file.
  #   required: true

  # vcpu_num:
  #   type: int
  #   description: |
  #     Number of virtual CPUs for each Zephyr VM (supports SMP).
  #   required: true
```

## samples/subsys/zvm/dts/bindings/virt,pci.yaml
```yaml
description: Virtual Machine virtual pci devices.

compatible: "virt,pci"

include: base.yaml

properties:
  reg:
    required: false

  label:
    type: string

  type:
    type: int
    required: true
    description: |
      VM's pci device type, including ivshmem,
      bridge and common device. See 'virt_pci.h'.

  domain:
    type: int
    required: true
    description: |
      PCI device domain.

  bdf:
    type: int
    required: true
    description: |
      PCI device address, including bus-device-function.

  bar_mask0:
    type: int
    required: true
    description: |
      PCI device base address mask value.

  bar_mask1:
    type: int
    required: true

  bar_mask2:
    type: int
    required: true

  bar_mask3:
    type: int
    required: true

  bar_mask4:
    type: int
    required: true

  bar_mask5:
    type: int
    required: true

  shmem_region_start:
    type: int
    required: true
    description: |
      shared memory region start.

  shmem_dev_id:
    type: int

  shmem_peers:
    type: int

  shmem_protocol:
    type: int

  status:
    type: string
```

## samples/subsys/zvm/dts/bindings/virtio,mmio.yaml
```yaml
description: virtio mmio device

compatible: "virtio,mmio"

include: base.yaml

properties:
    device_type:
      type: string
      required: true

    virtio_type:
      type: int
      required: true
```

## samples/subsys/zvm/dts/bindings/zephyr-cpy.yaml
```yaml
description: Zephyr Copy

compatible: "zephyr-cpy"

properties:
  vcpu_num:
    type: int
    description: |
      Number of virtual CPUs for each Zephyr VM (supports SMP).
    required: true
  max_mem_size:
    type: int
    description: |
      Max size of memory region
    required: true
  reg:
    type: array
    required: true
    description: |
      Reg regions for the VM.
```

## subsys/zvm/Kconfig
```kconfig
# Copyright 2024-2025 HNU-ESNL: Guoqi Xie, Chenglai Xiong, Xingyu Hu and etc.
# Copyright 2024-2025 openEuler SIG-Zephyr
# SPDX-License-Identifier: Apache-2.0

source "subsys/zvm/vdev/Kconfig"

menuconfig ZVM
	bool "Zephyr Based Virtual Machine"
	default n
	select USERSPACE
	help
	  Enable Zephyr virtualization support.

if ZVM

config ZVM_INIT_PRIORITY
	int "ZVM Initialization Priority"
	default 80
	help
	  Set the initialization priority for the ZVM module.

config MAX_VM_NUM
	int "Maximum Number of Simultaneous VMs"
	range 0 32
	default 2
	help
	  Define the maximum number of VMs that can run simultaneously in the ZVM hypervisor.

config DEFAULT_TOTAL_GUEST_MEMSIZE
	int "Byte"
	default 2684354560 if SOC_RK3588 # 2.5 G
	default 1073741824 # 1G
	help
	  Specify the maximum number of vCPUs that each VM can possess.

config MAX_VCPU_PER_VM
	int "Maximum Number of vCPUs per VM"
	range 1 4
	default 4
	help
	  Specify the maximum number of vCPUs that each VM can possess.

config MAX_VIRT_IRQ_NR
	int "maximum vm irq number for each board"
	default 256
	help
		Set the maximum vm irq number for each board. Because
		device of each board is different.

config ZVM_DEBUG
    bool "Enable debug-level logging"
    default n
    depends on LOG
    help
        Enable debug-level logging for the application.

config ZVM_DEBUG_LOG_INFO
	bool "Enable System Boot Info Logging"
	help
	  Enable logging of system boot information for debugging purposes.

config ZVM_SMP_DEBUG_INFO
	bool "Enable SMP Debug Information"
	default n
	help
	  Enable logging of SMP debug information, including CPU node IDs and vmpidr_el2 values.

config VM_DTB_FILE_INPUT
	bool "Parse DTB File for Linux VM"
	help
	  Enable parsing of the Device Tree Blob (DTB) file for Linux VMs.

config VM_VIRTIO_MMIO
	bool "virtio_mmio"
	help
		This option is selected by any subsystem which implements the virtio
	  	mmio.

config ZVM_VCPU_MULTI
	bool "vcpu threads migrating information"
	default n
	help
		This option is selected by any subsystem which implements the zvm

config MAX_VCPU_PERCPU
	int "vcpu number per pcpu."
	default 2 if ZVM_VCPU_MULTI
	default 1
	help
		The number of vcpu thread.

config VCPU_THREAD_STACKSIZE
	int "vCPU Thread Stack Size"
	default 40960
	help
	  Set the stack size for each vCPU thread in the VM.

config VCPU_MIGRATING_INFO
	bool "vcpu threads migrating information"
	default n
	help
		This option is selected by any subsystem which implements the zvm

if VM_VIRTIO_MMIO

config VIRTIO_INTERRUPT_DRIVEN
	bool "VM virtio interrupt driver."
	default y
	help
		Enable it if system need virtio mmio interrupt.

config VIRTIO_MMIO_INIT_PRIORITY
	int "VM virtio mmio init priority."
	default 60
	help
		When virtio is init, it judge the initialization priority in POST_KERNLE.

config VM_VIRTIO_MMIO_DEBUG
	bool "Debug log for vm virtio"
	default n
	help
		Enable it if system need virtio mmio debug info.

endif # VM_VIRTIO_MMIO

if ZVM_VCPU_MULTI

config VCPU_MIGRATING_INFO
	bool "vcpu threads migrating information"
	default n
	help
		This option is selected by any subsystem which implements the zvm

endif # ZVM_VCPU_MULTI

config ZVM_OPERATION_TEST
    bool "Enable VM operation tests in ZVM"
	depends on HEARTBEAT
	default n
    help
      Enable automated test cases for VM lifecycle operations,
      including create, run, pause, shutdown, reboot, and delete. This is
      primarily intended for validation and regression testing of ZVM's
      core VM management logic.

config ZVM_CLIENT
    bool "Enable ZVM client"
	depends on SOC_RK3588
	default n
    help
      feature to connect to frontend (pyqt)

config ZVM_MEMORY_RECORDER
    bool "Enable ZVM memory recorder"
	depends on ZVM_CLIENT
    help
      feature to ZVM_CLIENT

endif # ZVM
```

## subsys/zvm/vdev/Kconfig
```kconfig
# Copyright 2024-2025 HNU-ESNL: Guoqi Xie, Chenglai Xiong, Xingyu Hu and etc.
# Copyright 2024-2025 openEuler SIG-Zephyr
# SPDX-License-Identifier: Apache-2.0

menuconfig ZVM_DEVICE_SUPPORT
	bool "Zephyr Based Virtualization Device Menu"
	default y
	help
		Enable support for Zephyr-based virtualization devices.

config VIRT_DEVICE_INTERRUPT_DRIVEN
	bool "ZVM Virtualization Device Interrupt Support"
	default y
	help
		Enable interrupt support for ZVM virtualization devices.
		This option must be selected to set the callback function
		when VM devices require interrupts.

config VM_VGICV3
	bool "VGICv3 Device Support"
	help
		Enable support for the VGICv3 device, which is used
		when setting up a VM.

if VM_VGICV3

config VM_VGICV3_INIT_PRIORITY
	int "VGICv3 Initialization Priority"
	default 52
	help
		Set the initialization priority for the VGICv3 device.
		This is evaluated at the POST_KERNEL level.

endif

config VM_VSERIAL
	bool "VM VSERIAL that get from vm."
	help
		This option is used for building memory that get from overlay.

if VM_VSERIAL

config VM_VSERIAL_INIT_PRIORITY
	int "VM virt serial init priority."
	default 52
	help
		When serial is init, it judge the initialization priority in POST_KERNLE.

config VIRT_SERIAL_CTRL_INIT_PRIORITY
	int "VM virt serial ctrl block init priority."
	default 51
	help
		When serial is init, it judge the initialization priority in POST_KERNLE.

endif

config VM_SYSCON_CONTROLLER
	bool "VM syscon controller."
	help
		For hardware board, the system register may be configuration to multiple modes.
		VM which needs these system configurations may access syscon, ZVM must manager
		these configuration and determining which io function can be edit.

if VM_SYSCON_CONTROLLER

config VM_SYSCON_CONTROLLER_INIT_PRIORITY
	int "VM syscon controller init priority."
	default 60
	help
		When virt syscon is init, it judge the initialization priority in POST_KERNLE.

endif

config VM_CLOCK_SYSTEM_CONTROLLER
	bool "VM clock system controller."
	help
		Some VMs may need to access clock syscon device, which is not suitable
		to passthrough. ZVM must manager these clock devices and determining which
		devices can be accessed.

if VM_CLOCK_SYSTEM_CONTROLLER

config VM_CLOCK_SYSTEM_CONTROLLER_INIT_PRIORITY
	int "VM system clock controller init priority."
	default 58
	help
		When virt system clock is init, it judge the initialization priority in POST_KERNLE.

endif

config VM_FIQ_DEBUGGER
	bool "Linux VM debugger console on rk3568/rk3588."
	help
		When booting linux VM on rk3568/rk3588, a debugger console must be inited,
		this option is used to map irq to linux vm.

if VM_FIQ_DEBUGGER

config VM_FIQ_DEBUGGER_INIT_PRIORITY
	int "VM fiq debugger init priority."
	default 62
	help
		When fiq debugger is init, it judge the initialization priority in POST_KERNLE.

endif

if VM_VIRTIO_MMIO

config VM_VIRTIO_BLOCK
	bool "VM virtio_mmio block for vm."
	help
		This option is selected by any subsystem which implements the virtio_block
		using virtio_mmio.

config VM_VIRTIO_NET
	bool "VM virtio_mmio net for vm."
	help
		This option is selected by any subsystem which implements the virtio_net
		using virtio_mmio.
endif

config ZSHM
	bool "zvm inter-vm shared memory."
	help
		This option is used for building zvm inter-vm shared memory that get from overlay.

config HEARTBEAT
	bool "zvm shared memory device for heartbeat."
	help
		This option is used for building zvm shared memory device for heartbeat.

if ZSHM

config ZSHM_INIT_PRIORITY
	int "zvm inter-vm shared memory init priority."
	default 59
	help
		When zvm inter-vm shared memory is init, it judge the initialization priority in POST_KERNLE.
endif


if SOC_FAMILY_ROCKCHIP

config VIRT_RK_LINUXDEV_INIT_PRIORITY
	int "zvm shared memory device for heartbeat init priority."
	default 58
	help
		When zvm heartbeat dev is init, it judge the initialization priority in POST_KERNLE.
endif
```
